## boards/shields/split52_17/Kconfig.defconfig
```kconfig
if SHIELD_SPLIT52_17_RIGHT

config ZMK_KEYBOARD_NAME
    default "split52_17"

endif

if SHIELD_SPLIT52_17_LEFT || SHIELD_SPLIT52_17_RIGHT

config ZMK_SPLIT
    default y

endif
```

## boards/shields/split52_17/Kconfig.shield
```kconfig
config SHIELD_SPLIT52_17_LEFT
    def_bool $(shields_list_contains,split52_17_left)
config SHIELD_SPLIT52_17_RIGHT
    def_bool $(shields_list_contains,split52_17_right)
```
